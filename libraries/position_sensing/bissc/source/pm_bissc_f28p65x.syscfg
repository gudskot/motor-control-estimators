/**
 * @cliArgs --device "F28P65x" --package "256ZEJ" --part "F28P65x_256ZEJ" --context "CPU1" --product "C2000WARE@5.01.00.00"
 * @versions {"tool":"1.20.0+3587"}
 */
scripting.excludeFromBuild("board.c");
scripting.excludeFromBuild("board.h");
scripting.excludeFromBuild("board.cmd.genlibs");
scripting.excludeFromBuild("board.opt");
scripting.excludeFromBuild("pinmux.csv");
scripting.excludeFromBuild("c2000ware_libraries.cmd.genlibs");
scripting.excludeFromBuild("c2000ware_libraries.opt");
scripting.excludeFromBuild("c2000ware_libraries.c");
scripting.excludeFromBuild("c2000ware_libraries.h");
scripting.excludeFromBuild("clocktree.h");

/**
 * Import the modules used in this configuration.
 */
const TILE                             = scripting.addModule("/utilities/clb_tool/clb_syscfg/source/TILE");
const TILE1                            = TILE.addInstance();
const TILE2                            = TILE.addInstance();
const clb_run_dynamic_template_clb_c   = scripting.addModule("/utilities/clb_tool/clb_syscfg/source/clb_run_dynamic_template_clb_c.js");
const clb_run_dynamic_template_clb_dot = scripting.addModule("/utilities/clb_tool/clb_syscfg/source/clb_run_dynamic_template_clb_dot.js");
const clb_run_dynamic_template_clb_h   = scripting.addModule("/utilities/clb_tool/clb_syscfg/source/clb_run_dynamic_template_clb_h.js");
const clb_run_dynamic_template_clb_sim = scripting.addModule("/utilities/clb_tool/clb_syscfg/source/clb_run_dynamic_template_clb_sim.js");

/**
 * Write custom configuration values to the imported modules.
 */
TILE.generateSimulation = true;
TILE.clock_period       = 10000;
TILE.sim_duration       = 200000000;
TILE.reset_duration     = 1000;

TILE1.$name                        = "BISSC_CLK_GEN_TILE";
TILE1.BOUNDARY.$name               = "BOUNDARY3";
TILE1.BOUNDARY.in_period1          = 400;
TILE1.BOUNDARY.in_duty1            = 200;
TILE1.BOUNDARY.in_repeat_count1    = 10000;
TILE1.BOUNDARY.boundaryInput0      = "customWave";
TILE1.BOUNDARY.in_initial_value1   = 1;
TILE1.BOUNDARY.boundaryInput1      = "customWave";
TILE1.BOUNDARY.boundaryInput2      = "tileOutput";
TILE1.BOUNDARY.tileSelect2         = "BISSC_FSM_GEN_TILE";
TILE1.BOUNDARY.boundaryInput3      = "tileOutput";
TILE1.BOUNDARY.tileSelect3         = "BISSC_FSM_GEN_TILE";
TILE1.BOUNDARY.tileSelect4         = "BISSC_FSM_GEN_TILE";
TILE1.BOUNDARY.tileOutputSelect4   = 5;
TILE1.BOUNDARY.in_custom_source1   = "#define RESET 40\n#define HALF_WIDTH 10\n#define WIDTH 20\n#define WAIT_FOR_START_OP 40\n#define WAIT_FOR_END_OP 40\n#define DELAY_MESSAGE1 60\n#define WAIT_FOR_TIMEOUT1 200\n#define DELAY_MESSAGE2 75\n#define DELAY_ACK2 80\n#define WAIT_FOR_TIMEOUT2 80\n#define DELAY_MESSAGE3 97\n#define DELAY_ACK3 120\n#define WAIT_FOR_TIMEOUT3 200\n#define HEADER 20\n#define DATA 20\nhigh(RESET)\nhigh(WAIT_FOR_START_OP)\nhigh(DELAY_MESSAGE1)\nlow(HEADER)\nhigh(HEADER)\nlow(HEADER)\nlow(HEADER)\nrpt(3)\nhigh(DATA)\nrpt_end\nrpt(5)\nlow(DATA)\nrpt_end\nhigh(DATA)\nrpt(3)\nlow(DATA)\nrpt_end\nrpt(3)\nhigh(DATA)\nrpt_end\nlow(DATA)\nrpt(3)\nhigh(DATA)\nrpt_end\nlow(WAIT_FOR_TIMEOUT1)\nhigh(WAIT_FOR_END_OP)\nhigh(WAIT_FOR_START_OP)\nhigh(DELAY_MESSAGE2)\nlow(HEADER)\nlow(DELAY_ACK2)\nhigh(HEADER)\nlow(HEADER)\nlow(HEADER)\nrpt(3)\nhigh(DATA)\nrpt_end\nrpt(5)\nlow(DATA)\nrpt_end\nhigh(DATA)\nrpt(3)\nlow(DATA)\nrpt_end\nrpt(3)\nhigh(DATA)\nrpt_end\nlow(DATA)\nrpt(3)\nhigh(DATA)\nrpt_end\nlow(WAIT_FOR_TIMEOUT2)\nhigh(WAIT_FOR_END_OP)\nhigh(WAIT_FOR_START_OP)\nhigh(DELAY_MESSAGE3)\nlow(HEADER)\nlow(DELAY_ACK3)\nhigh(HEADER)\nlow(HEADER)\nlow(HEADER)\nrpt(3)\nhigh(DATA)\nrpt_end\nrpt(5)\nlow(DATA)\nrpt_end\nhigh(DATA)\nrpt(3)\nlow(DATA)\nrpt_end\nrpt(3)\nhigh(DATA)\nrpt_end\nlow(DATA)\nrpt(3)\nhigh(DATA)\nrpt_end\nlow(WAIT_FOR_TIMEOUT3)\nhigh(1)";
TILE1.BOUNDARY.in_sync1            = true;
TILE1.BOUNDARY.in_custom_source0   = "#define RESET 40\n#define HALF_WIDTH 10\n#define WIDTH 20\n#define WAIT_FOR_START_OP 40\n#define WAIT_FOR_END_OP 40\n#define DELAY_MESSAGE1 60\n#define WAIT_FOR_TIMEOUT1 200\n#define DELAY_MESSAGE2 75\n#define DELAY_ACK2 80\n#define WAIT_FOR_TIMEOUT2 80\n#define DELAY_MESSAGE3 97\n#define DELAY_ACK3 120\n#define WAIT_FOR_TIMEOUT3 200\n#define HEADER 20\n#define DATA 20\nlow(RESET)\nlow(WAIT_FOR_START_OP)\nhigh(DELAY_MESSAGE1)\nhigh(HEADER)\nhigh(HEADER)\nhigh(HEADER)\nhigh(HEADER)\nrpt(3)\nhigh(DATA)\nrpt_end\nrpt(5)\nhigh(DATA)\nrpt_end\nhigh(DATA)\nrpt(3)\nhigh(DATA)\nrpt_end\nrpt(3)\nhigh(DATA)\nrpt_end\nhigh(DATA)\nrpt(3)\nhigh(DATA)\nrpt_end\nhigh(WAIT_FOR_TIMEOUT1)\nlow(WAIT_FOR_END_OP)\nlow(WAIT_FOR_START_OP)\nhigh(DELAY_MESSAGE2)\nhigh(HEADER)\nhigh(DELAY_ACK2)\nhigh(HEADER)\nhigh(HEADER)\nhigh(HEADER)\nrpt(3)\nhigh(DATA)\nrpt_end\nrpt(5)\nhigh(DATA)\nrpt_end\nhigh(DATA)\nrpt(3)\nhigh(DATA)\nrpt_end\nrpt(3)\nhigh(DATA)\nrpt_end\nhigh(DATA)\nrpt(3)\nhigh(DATA)\nrpt_end\nhigh(WAIT_FOR_TIMEOUT2)\nlow(WAIT_FOR_END_OP)\nlow(WAIT_FOR_START_OP)\nhigh(DELAY_MESSAGE3)\nhigh(HEADER)\nhigh(DELAY_ACK3)\nhigh(HEADER)\nhigh(HEADER)\nhigh(HEADER)\nrpt(3)\nhigh(DATA)\nrpt_end\nrpt(5)\nhigh(DATA)\nrpt_end\nhigh(DATA)\nrpt(3)\nhigh(DATA)\nrpt_end\nrpt(3)\nhigh(DATA)\nrpt_end\nhigh(DATA)\nrpt(3)\nhigh(DATA)\nrpt_end\nhigh(WAIT_FOR_TIMEOUT3)\nlow(1)";
TILE1.BOUNDARY.input_pipeline2     = true;
TILE1.BOUNDARY.input_pipeline3     = true;
TILE1.BOUNDARY.input_pipeline4     = true;
TILE1.BOUNDARY.tileOutputSelect3   = 1;
TILE1.BOUNDARY.tileOutputSelect2   = 2;
TILE1.LUT_0.$name                  = "LUT_9";
TILE1.LUT_0.i0                     = "BOUNDARY.in1";
TILE1.LUT_0.i1                     = "BOUNDARY.in2";
TILE1.LUT_0.i2                     = "BOUNDARY.in3";
TILE1.LUT_0.i3                     = "COUNTER_1.count_match2";
TILE1.LUT_0.eqn                    = "(i0 & i2 & (~i1)) | i3 | (!i2 & !i1)";
TILE1.LUT_0.lutDescription         = "CLB_SPI_CLOCK duty reset control\ni0: ENCODER_RESPONSE\ni1, i2: FRAME_STATE\ni3: SPI_CLOCK width reached";
TILE1.LUT_1.$name                  = "LUT_10";
TILE1.LUT_2.$name                  = "LUT_11";
TILE1.FSM_0.$name                  = "FSM_9";
TILE1.FSM_0.eqn_s0                 = "((~s0) & e0) | (s0& (~e1))";
TILE1.FSM_0.e0                     = "COUNTER_0.count_match1";
TILE1.FSM_0.e1                     = "COUNTER_0.count_zero";
TILE1.FSM_0.fsmDescription         = "ENCODER_CLOCK (MA) generation";
TILE1.FSM_1.$name                  = "FSM_10";
TILE1.FSM_1.eqn_s0                 = "((~s0) & e0 & (~e1)) | (s0 & (~e1)) ";
TILE1.FSM_1.e0                     = "COUNTER_1.count_match1";
TILE1.FSM_1.e1                     = "COUNTER_1.count_zero";
TILE1.FSM_1.fsmDescription         = "SPI_CLOCK edge generation";
TILE1.FSM_2.$name                  = "FSM_11";
TILE1.COUNTER_0.$name              = "COUNTER_9";
TILE1.COUNTER_0.mode1              = "1";
TILE1.COUNTER_0.mode0              = "BOUNDARY.in0";
TILE1.COUNTER_0.reset              = "COUNTER_0.count_match2";
TILE1.COUNTER_0.match1_val         = "9";
TILE1.COUNTER_0.match2_val         = "19";
TILE1.COUNTER_0.counterDescription = "ENCODER_CLOCK (MA) duty and frequency control";
TILE1.COUNTER_1.$name              = "COUNTER_10";
TILE1.COUNTER_1.mode1              = "1";
TILE1.COUNTER_1.reset              = "LUT_0.OUT";
TILE1.COUNTER_1.mode0              = "BOUNDARY.in0";
TILE1.COUNTER_1.match1_val         = "9";
TILE1.COUNTER_1.match2_val         = "19";
TILE1.COUNTER_1.counterDescription = "SPI_CLOCK - Duty and frequency control";
TILE1.COUNTER_2.$name              = "COUNTER_11";
TILE1.OUTLUT_0.$name               = "OUTLUT_24";
TILE1.OUTLUT_1.$name               = "OUTLUT_25";
TILE1.OUTLUT_1.eqn                 = "i0";
TILE1.OUTLUT_1.i0                  = "FSM_0.S0";
TILE1.OUTLUT_2.$name               = "OUTLUT_26";
TILE1.OUTLUT_2.i0                  = "FSM_1.S0";
TILE1.OUTLUT_2.eqn                 = "i0";
TILE1.OUTLUT_3.$name               = "OUTLUT_27";
TILE1.OUTLUT_3.eqn                 = "i0";
TILE1.OUTLUT_3.i0                  = "BOUNDARY.in1";
TILE1.OUTLUT_4.$name               = "OUTLUT_28";
TILE1.OUTLUT_5.$name               = "OUTLUT_29";
TILE1.OUTLUT_6.$name               = "OUTLUT_30";
TILE1.OUTLUT_7.$name               = "OUTLUT_31";
TILE1.HLC.$name                    = "HLC_3";
TILE1.HLC.program0.$name           = "HLCP_12";
TILE1.HLC.program1.$name           = "HLCP_13";
TILE1.HLC.program2.$name           = "HLCP_14";
TILE1.HLC.program3.$name           = "HLCP_15";
TILE1.AOC_0.$name                  = "AOC_0";
TILE1.AOC_1.$name                  = "AOC_1";
TILE1.AOC_2.$name                  = "AOC_2";
TILE1.AOC_3.$name                  = "AOC_3";
TILE1.AOC_4.$name                  = "AOC_4";
TILE1.AOC_5.$name                  = "AOC_5";
TILE1.AOC_6.$name                  = "AOC_6";
TILE1.AOC_7.$name                  = "AOC_7";

TILE2.$name                        = "BISSC_FSM_GEN_TILE";
TILE2.BOUNDARY.$name               = "BOUNDARY0";
TILE2.BOUNDARY.in_repeat_count1    = 10000;
TILE2.BOUNDARY.in_period0          = 1000;
TILE2.BOUNDARY.in_duty0            = 100;
TILE2.BOUNDARY.in_repeat_count0    = 10000;
TILE2.BOUNDARY.in_period1          = 400;
TILE2.BOUNDARY.in_duty1            = 200;
TILE2.BOUNDARY.boundaryInput0      = "customWave";
TILE2.BOUNDARY.boundaryInput1      = "customWave";
TILE2.BOUNDARY.in_edge1            = "rising edge";
TILE2.BOUNDARY.boundaryInput2      = "tileOutput";
TILE2.BOUNDARY.tileSelect2         = "BISSC_CLK_GEN_TILE";
TILE2.BOUNDARY.boundaryInput3      = "tileOutput";
TILE2.BOUNDARY.tileSelect3         = "BISSC_CLK_GEN_TILE";
TILE2.BOUNDARY.in_edge3            = "rising edge";
TILE2.BOUNDARY.boundaryInput4      = "tileOutput";
TILE2.BOUNDARY.tileSelect4         = "BISSC_CLK_GEN_TILE";
TILE2.BOUNDARY.boundaryInput5      = "tileOutput";
TILE2.BOUNDARY.in_edge5            = "rising edge";
TILE2.BOUNDARY.tileSelect5         = "BISSC_CLK_GEN_TILE";
TILE2.BOUNDARY.in_edge0            = "rising edge";
TILE2.BOUNDARY.boundaryInput7      = "customWave";
TILE2.BOUNDARY.in_custom_source1   = "#define RESET 40\n#define HALF_WIDTH 10\n#define WIDTH 20\n#define WAIT_FOR_START_OP 40\n#define WAIT_FOR_END_OP 40\n#define DELAY_MESSAGE1 60\n#define WAIT_FOR_TIMEOUT1 200\n#define DELAY_MESSAGE2 75\n#define DELAY_ACK2 80\n#define WAIT_FOR_TIMEOUT2 80\n#define DELAY_MESSAGE3 97\n#define DELAY_ACK3 120\n#define WAIT_FOR_TIMEOUT3 200\n#define HEADER 20\n#define DATA 20\nhigh(RESET)\nhigh(WAIT_FOR_START_OP)\nhigh(DELAY_MESSAGE1)\nlow(HEADER)\nhigh(HEADER)\nlow(HEADER)\nlow(HEADER)\nrpt(3)\nhigh(DATA)\nrpt_end\nrpt(5)\nlow(DATA)\nrpt_end\nhigh(DATA)\nrpt(3)\nlow(DATA)\nrpt_end\nrpt(3)\nhigh(DATA)\nrpt_end\nlow(DATA)\nrpt(3)\nhigh(DATA)\nrpt_end\nlow(WAIT_FOR_TIMEOUT1)\nhigh(WAIT_FOR_END_OP)\nhigh(WAIT_FOR_START_OP)\nhigh(DELAY_MESSAGE2)\nlow(HEADER)\nlow(DELAY_ACK2)\nhigh(HEADER)\nlow(HEADER)\nlow(HEADER)\nrpt(3)\nhigh(DATA)\nrpt_end\nrpt(5)\nlow(DATA)\nrpt_end\nhigh(DATA)\nrpt(3)\nlow(DATA)\nrpt_end\nrpt(3)\nhigh(DATA)\nrpt_end\nlow(DATA)\nrpt(3)\nhigh(DATA)\nrpt_end\nlow(WAIT_FOR_TIMEOUT2)\nhigh(WAIT_FOR_END_OP)\nhigh(WAIT_FOR_START_OP)\nhigh(DELAY_MESSAGE3)\nlow(HEADER)\nlow(DELAY_ACK3)\nhigh(HEADER)\nlow(HEADER)\nlow(HEADER)\nrpt(3)\nhigh(DATA)\nrpt_end\nrpt(5)\nlow(DATA)\nrpt_end\nhigh(DATA)\nrpt(3)\nlow(DATA)\nrpt_end\nrpt(3)\nhigh(DATA)\nrpt_end\nlow(DATA)\nrpt(3)\nhigh(DATA)\nrpt_end\nlow(WAIT_FOR_TIMEOUT3)\nhigh(1)";
TILE2.BOUNDARY.in_custom_source7   = "#define RESET 40\n#define HALF_WIDTH 10\n#define WIDTH 20\n#define WAIT_FOR_START_OP 40\n#define WAIT_FOR_END_OP 40\n#define DELAY_MESSAGE1 60\n#define WAIT_FOR_TIMEOUT1 200\n#define DELAY_MESSAGE2 75\n#define DELAY_ACK2 80\n#define WAIT_FOR_TIMEOUT2 80\n#define DELAY_MESSAGE3 97\n#define DELAY_ACK3 120\n#define WAIT_FOR_TIMEOUT3 200\n#define HEADER 20\n#define DATA 20\nhigh(RESET)\nhigh(WAIT_FOR_START_OP)\nhigh(DELAY_MESSAGE1)\nhigh(HEADER)\nhigh(HEADER)\nhigh(HEADER)\nhigh(HEADER)\nrpt(3)\nhigh(DATA)\nrpt_end\nrpt(5)\nhigh(DATA)\nrpt_end\nhigh(DATA)\nrpt(3)\nhigh(DATA)\nrpt_end\nrpt(3)\nhigh(DATA)\nrpt_end\nhigh(DATA)\nrpt(3)\nhigh(DATA)\nrpt_end\nhigh(WAIT_FOR_TIMEOUT1)\nhigh(WAIT_FOR_END_OP)\nhigh(WAIT_FOR_START_OP)\nlow(DELAY_MESSAGE2)\nlow(HEADER)\nlow(DELAY_ACK2)\nlow(HEADER)\nlow(HEADER)\nlow(HEADER)\nrpt(3)\nlow(DATA)\nrpt_end\nrpt(5)\nlow(DATA)\nrpt_end\nlow(DATA)\nrpt(3)\nlow(DATA)\nrpt_end\nrpt(3)\nlow(DATA)\nrpt_end\nlow(DATA)\nrpt(3)\nlow(DATA)\nrpt_end\nlow(WAIT_FOR_TIMEOUT2)\nlow(WAIT_FOR_END_OP)\nlow(WAIT_FOR_START_OP)\nlow(DELAY_MESSAGE2)\nlow(HEADER)\nlow(DELAY_ACK3)\nlow(HEADER)\nlow(HEADER)\nlow(HEADER)\nrpt(3)\nlow(DATA)\nrpt_end\nrpt(5)\nlow(DATA)\nrpt_end\nlow(DATA)\nrpt(3)\nlow(DATA)\nrpt_end\nrpt(3)\nlow(DATA)\nrpt_end\nlow(DATA)\nrpt(3)\nlow(DATA)\nrpt_end\nlow(WAIT_FOR_TIMEOUT3)\nlow(1)";
TILE2.BOUNDARY.in_custom_source0   = "#define RESET 40\n#define HALF_WIDTH 10\n#define WIDTH 20\n#define WAIT_FOR_START_OP 40\n#define WAIT_FOR_END_OP 40\n#define DELAY_MESSAGE1 60\n#define WAIT_FOR_TIMEOUT1 200\n#define DELAY_MESSAGE2 75\n#define DELAY_ACK2 80\n#define WAIT_FOR_TIMEOUT2 80\n#define DELAY_MESSAGE3 97\n#define DELAY_ACK3 120\n#define WAIT_FOR_TIMEOUT3 200\n#define HEADER 20\n#define DATA 20\nlow(RESET)\nlow(WAIT_FOR_START_OP)\nhigh(DELAY_MESSAGE1)\nhigh(HEADER)\nhigh(HEADER)\nhigh(HEADER)\nhigh(HEADER)\nrpt(3)\nhigh(DATA)\nrpt_end\nrpt(5)\nhigh(DATA)\nrpt_end\nhigh(DATA)\nrpt(3)\nhigh(DATA)\nrpt_end\nrpt(3)\nhigh(DATA)\nrpt_end\nhigh(DATA)\nrpt(3)\nhigh(DATA)\nrpt_end\nhigh(WAIT_FOR_TIMEOUT1)\nlow(WAIT_FOR_END_OP)\nlow(WAIT_FOR_START_OP)\nhigh(DELAY_MESSAGE2)\nhigh(HEADER)\nhigh(DELAY_ACK2)\nhigh(HEADER)\nhigh(HEADER)\nhigh(HEADER)\nrpt(3)\nhigh(DATA)\nrpt_end\nrpt(5)\nhigh(DATA)\nrpt_end\nhigh(DATA)\nrpt(3)\nhigh(DATA)\nrpt_end\nrpt(3)\nhigh(DATA)\nrpt_end\nhigh(DATA)\nrpt(3)\nhigh(DATA)\nrpt_end\nhigh(WAIT_FOR_TIMEOUT2)\nlow(WAIT_FOR_END_OP)\nlow(WAIT_FOR_START_OP)\nhigh(DELAY_MESSAGE3)\nhigh(HEADER)\nhigh(DELAY_ACK3)\nhigh(HEADER)\nhigh(HEADER)\nhigh(HEADER)\nrpt(3)\nhigh(DATA)\nrpt_end\nrpt(5)\nhigh(DATA)\nrpt_end\nhigh(DATA)\nrpt(3)\nhigh(DATA)\nrpt_end\nrpt(3)\nhigh(DATA)\nrpt_end\nhigh(DATA)\nrpt(3)\nhigh(DATA)\nrpt_end\nhigh(WAIT_FOR_TIMEOUT3)\nlow(1)";
TILE2.BOUNDARY.input_pipeline1     = true;
TILE2.BOUNDARY.input_pipeline0     = true;
TILE2.BOUNDARY.input_pipeline2     = true;
TILE2.BOUNDARY.input_pipeline3     = true;
TILE2.BOUNDARY.input_pipeline4     = true;
TILE2.BOUNDARY.input_pipeline5     = true;
TILE2.BOUNDARY.input_pipeline7     = true;
TILE2.BOUNDARY.tileOutputSelect2   = 1;
TILE2.BOUNDARY.tileOutputSelect3   = 1;
TILE2.BOUNDARY.tileOutputSelect5   = 2;
TILE2.BOUNDARY.tileOutputSelect4   = 2;
TILE2.LUT_0.$name                  = "LUT_0";
TILE2.LUT_0.i0                     = "COUNTER_1.count_match1";
TILE2.LUT_0.i2                     = "BOUNDARY.in0";
TILE2.LUT_0.i3                     = "BOUNDARY.in3";
TILE2.LUT_0.eqn                    = "(i0  & i3) | i2";
TILE2.LUT_0.lutDescription         = "out: high for 1 clb clock in the following conditions\na) START_OPERATION_RE\nb) RECEIVE_DATA_COMPLETE. This is aligned to the rising edge of the ENCODER_CLOCK \n";
TILE2.LUT_1.$name                  = "LUT_1";
TILE2.LUT_1.i0                     = "BOUNDARY.in3";
TILE2.LUT_1.i1                     = "FSM_1.S0";
TILE2.LUT_1.i2                     = "FSM_1.S1";
TILE2.LUT_1.lutDescription         = "Qualification for the ENCODER_CLOCK_RE. \nOnly pass on the ENCODER_CLOCK_RE if \n(1) FRAME_STATE == TRANSMIT (state 01) or \n(2) FRAME_STATE == TRANSMIT_AND_RECEIVE (state 10)";
TILE2.LUT_1.eqn                    = "i0 & (!i2 & i1 | i2 & !i1)";
TILE2.LUT_2.$name                  = "LUT_2";
TILE2.LUT_2.eqn                    = "i0 & (i1 & (~i2))";
TILE2.LUT_2.i1                     = "FSM_1.S0";
TILE2.LUT_2.i2                     = "FSM_1.S1";
TILE2.LUT_2.i0                     = "BOUNDARY.in1";
TILE2.LUT_2.lutDescription         = "Detect the ACK from the encoder. \nIf the FRAME_STATE is WAIT_FOR_ACK (0,1) and ENCODER_RESPONSE_RE goes high, then ACK has been detected.\nout: will transition from low to high for one CLB clock when ACK is detected";
TILE2.FSM_0.$name                  = "FSM_0";
TILE2.FSM_0.xe0                    = "BOUNDARY.in2";
TILE2.FSM_0.xe1                    = "BOUNDARY.in7";
TILE2.FSM_0.e0                     = "FSM_1.S0";
TILE2.FSM_0.e1                     = "FSM_1.S1";
TILE2.FSM_0.eqn_out                = "~(( (~xe0) & (e0 ^ e1)) | ((~xe1) & (e0 & e1)))";
TILE2.FSM_0.fsmDescription         = "Append the CDM bit to the end of the MA signal";
TILE2.FSM_1.$name                  = "FSM_1";
TILE2.FSM_1.e0                     = "LUT_0.OUT";
TILE2.FSM_1.eqn_out                = "(!s0 & !s1)";
TILE2.FSM_1.e1                     = "BOUNDARY.in1";
TILE2.FSM_1.eqn_s0                 = "(!s1 & !s0 & e0) | (!s1 & s0 & !e1) | (s1 & !s0 & e0) | (s1 & s0)";
TILE2.FSM_1.eqn_s1                 = "(!s1 & s0 & e1) | (s1 & !s0) | (s1 & s0)";
TILE2.FSM_1.fsmDescription         = "Frame state generation\ne0: START_OPERATION_RE or ENCODER_CLOCK_COMPLETE\ne1: RESPONSE_RE\ns0,s1: FRAME_STATE\nout: IDLE";
TILE2.FSM_2.$name                  = "FSM_2";
TILE2.FSM_2.eqn_s0                 = "(((~s0)&(~s1)) & e1) | ((s0&(~s1)) & (~e0))";
TILE2.FSM_2.eqn_out                = "xe1 & s0";
TILE2.FSM_2.e0                     = "COUNTER_2.count_match1";
TILE2.FSM_2.e1                     = "FSM_1.S1";
TILE2.FSM_2.xe1                    = "BOUNDARY.in5";
TILE2.FSM_2.eqn_s1                 = "(~s1 & e0) | (s1 & e0 & e1) | (s1 & s0)";
TILE2.FSM_2.fsmDescription         = "CLB_SPI_CLOCK output enable and count enable";
TILE2.COUNTER_0.$name              = "COUNTER_0";
TILE2.COUNTER_1.$name              = "COUNTER_1";
TILE2.COUNTER_1.event_load_val     = "10";
TILE2.COUNTER_1.mode1              = "1";
TILE2.COUNTER_1.mode0              = "LUT_1.OUT";
TILE2.COUNTER_1.match1_val         = "200";
TILE2.COUNTER_1.reset              = "FSM_1.OUT";
TILE2.COUNTER_1.counterDescription = "Count the number of CLB_ENCODER_CLOCKS output ";
TILE2.COUNTER_2.$name              = "COUNTER_2";
TILE2.COUNTER_2.mode0              = "FSM_2.OUT";
TILE2.COUNTER_2.mode1              = "1";
TILE2.COUNTER_2.match1_val         = "24";
TILE2.COUNTER_2.reset              = "FSM_1.OUT";
TILE2.COUNTER_2.counterDescription = "Count the number of CLB_SPI_CLOCKs sent\n";
TILE2.OUTLUT_0.$name               = "OUTLUT_0";
TILE2.OUTLUT_0.eqn                 = "(~( (~i0) & (i1))) ";
TILE2.OUTLUT_0.i0                  = "BOUNDARY.in4";
TILE2.OUTLUT_0.i1                  = "FSM_2.S0";
TILE2.OUTLUT_0.outlutDescription   = "CLB_SPI_CLOCK";
TILE2.OUTLUT_1.$name               = "OUTLUT_1";
TILE2.OUTLUT_1.eqn                 = "i0";
TILE2.OUTLUT_1.i0                  = "BOUNDARY.in6";
TILE2.OUTLUT_1.outlutDescription   = "ENCODER_RESPONSE (delayed to match CLB_SPI_CLOCK delay)";
TILE2.OUTLUT_2.$name               = "OUTLUT_2";
TILE2.OUTLUT_2.i0                  = "FSM_1.S1";
TILE2.OUTLUT_2.eqn                 = "i0";
TILE2.OUTLUT_2.outlutDescription   = "FRAME_STATE.s1 output to BISSC_CLK_GEN_TILE";
TILE2.OUTLUT_3.$name               = "OUTLUT_3";
TILE2.OUTLUT_3.eqn                 = "i0";
TILE2.OUTLUT_3.outlutDescription   = "Tie SPI enable pin low (override SPISTE_IN)";
TILE2.OUTLUT_4.$name               = "OUTLUT_4";
TILE2.OUTLUT_4.i0                  = "FSM_0.OUT";
TILE2.OUTLUT_4.i2                  = "LUT_1.OUT";
TILE2.OUTLUT_4.i1                  = "COUNTER_1.count_match1";
TILE2.OUTLUT_4.eqn                 = "i0 & (~(i1&i2))";
TILE2.OUTLUT_4.outlutDescription   = "CLB_ENCODER_CLOCK (MA)";
TILE2.OUTLUT_5.$name               = "OUTLUT_5";
TILE2.OUTLUT_5.eqn                 = "i0";
TILE2.OUTLUT_5.i0                  = "FSM_1.S0";
TILE2.OUTLUT_5.outlutDescription   = "FRAME_STATE.s0 output to BISSC_CLK_GEN_TILE";
TILE2.OUTLUT_6.$name               = "OUTLUT_6";
TILE2.OUTLUT_6.eqn                 = "i0";
TILE2.OUTLUT_6.i0                  = "FSM_1.S1";
TILE2.OUTLUT_6.outlutDescription   = "FRAME_STATE.s1 for test only\n";
TILE2.OUTLUT_7.$name               = "OUTLUT_7";
TILE2.HLC.$name                    = "HLC_0";
TILE2.HLC.e0                       = "LUT_2.OUT";
TILE2.HLC.R0_init                  = "23";
TILE2.HLC.program0.$name           = "HLCP_0";
TILE2.HLC.program0.instruct0       = "MOV C1, R2";
TILE2.HLC.program0.instruct1       = "ADD R0, R2";
TILE2.HLC.program0.instruct2       = " MOV_T1 R2, C1";
TILE2.HLC.program0.instruct3       = " ADD R1, R2 ";
TILE2.HLC.program0.instruct4       = "MOV_T2\t R2,C1";
TILE2.HLC.program1.$name           = "HLCP_1";
TILE2.HLC.program2.$name           = "HLCP_2";
TILE2.HLC.program3.$name           = "HLCP_3";
TILE2.AOC_0.$name                  = "AOC_8";
TILE2.AOC_1.$name                  = "AOC_9";
TILE2.AOC_2.$name                  = "AOC_10";
TILE2.AOC_3.$name                  = "AOC_11";
TILE2.AOC_4.$name                  = "AOC_12";
TILE2.AOC_4.stage2_gate_mux        = "OUTPUT7";
TILE2.AOC_4.stage3_release_mux     = "OUTPUT7";
TILE2.AOC_4.stage3_mux             = "SET";
TILE2.AOC_5.$name                  = "AOC_13";
TILE2.AOC_6.$name                  = "AOC_14";
TILE2.AOC_7.$name                  = "AOC_15";
scripting.suppress("Equation uses a constant value input", TILE2.OUTLUT_3, "i0");
scripting.suppress("Equation uses a constant value input", TILE2.OUTLUT_3, "eqn");
