/**
 * @cliArgs --device "F28002x" --package "80QFP" --part "F28002x_80QFP" --product "C2000WARE@4.00.00.00"
 * @versions {"tool":"1.11.0+2202"}
 */

/**
 * Import the modules used in this configuration.
 */
const TILE  = scripting.addModule("/utilities/clb_tool/clb_syscfg/source/TILE");
const TILE1 = TILE.addInstance();

/**
 * Write custom configuration values to the imported modules.
 */
TILE.generateSimulation = true;
TILE.clock_period       = 10000;
TILE.sim_duration       = 500000000;
TILE.reset_duration     = 50000;

TILE1.$name                     = "TILE1";
TILE1.BOUNDARY.$name            = "BOUNDARY0";
TILE1.BOUNDARY.in_duty1          = 50;
TILE1.BOUNDARY.in_period1        = 100;
TILE1.BOUNDARY.in_repeat_count0  = 50;
TILE1.BOUNDARY.in_repeat_count3  = 1;
TILE1.BOUNDARY.in_repeat_count1  = 1000;
TILE1.BOUNDARY.in_duty0          = 20;
TILE1.BOUNDARY.in_period0        = 40;
TILE1.BOUNDARY.boundaryInput0    = "customWave";
TILE1.BOUNDARY.in_custom_source0 = "low(100)\nhigh(1)";
TILE1.BOUNDARY.boundaryInput1    = "customWave";
TILE1.BOUNDARY.in_custom_source1 = "low(10)\nhigh(1)";
TILE1.FSM_0.fsmDescription         = "QEP-A/B signal generation\ne0: DIRECTION via GPREG 0=reverse, 1=forward\ne1: QCLK\ns0: QEP-A\ns1: QEP-B";
TILE1.FSM_1.fsmDescription         = "Latch HALT state when PTO is complete\ne0: PTO_DONE\ne1: HALT/CLEAR LATCH\nout: 0=HALT 1=RUN";
TILE1.FSM_2.fsmDescription         = "QEP-I generation\ne0: QEP-I HIGH\ne1: QEP-I LOW\ns0: QEP-I";
TILE1.COUNTER_0.counterDescription = "Pulse width control\nmatch1: QCLK\nmatch2: width control\nmode0: RUN / HALT\nreset: WIDTH_CONTROL";
TILE1.COUNTER_1.counterDescription = "Detect end of PTO, count sent edges\nmatch1: HALT/CLEAR LATCH\nmatch2: PTO_DONE\nevent: QCLK, add 1\nreset: PTO_DONE";
TILE1.COUNTER_2.counterDescription = "QEP-I control, count sent edges\nmatch1: QEP-I HIGH\nmatch2: QEP-I LOW\nevent: QCLK, incrment by 1\nreset: PTO_DONE";
TILE1.OUTLUT_2.outlutDescription   = "PTO_QEP_I";
TILE1.OUTLUT_4.outlutDescription   = "PTO_QEP_A";
TILE1.OUTLUT_5.outlutDescription   = "PTO_QEP_B";
TILE1.LUT_0.$name               = "LUT_0";
TILE1.LUT_1.$name               = "LUT_1";
TILE1.LUT_2.$name               = "LUT_2";
TILE1.FSM_0.$name               = "FSM_0";
TILE1.FSM_0.e1                  = "COUNTER_0.count_match1";
TILE1.FSM_0.e0                  = "BOUNDARY.in1";
TILE1.FSM_0.eqn_s0              = "(s0 & !e1) | (e0 & !s1 & e1) | (!e0 & s1 & e1)";
TILE1.FSM_0.eqn_s1              = "(s1 & !e1) | (e0  & s0 & e1) | (!e0 & !s0 & e1)";
TILE1.FSM_1.$name               = "FSM_1";
TILE1.FSM_1.eqn_out             = "!(s0 | e1)";
TILE1.FSM_1.e0                  = "COUNTER_1.count_match2";
TILE1.FSM_1.e1                  = "COUNTER_1.count_match1";
TILE1.FSM_1.eqn_s0              = "(s0 & !e1) | (e0 & ! e1)";
TILE1.FSM_2.$name               = "FSM_2";
TILE1.FSM_2.e0                  = "COUNTER_2.count_match1";
TILE1.FSM_2.eqn_s0              = "(e0 & !e1) | (s0 & !e0 & !e1)";
TILE1.FSM_2.e1                  = "COUNTER_2.count_match2";
TILE1.COUNTER_0.$name           = "COUNTER_0";
TILE1.COUNTER_0.mode1           = "1";
TILE1.COUNTER_0.mode0           = "FSM_1.OUT";
TILE1.COUNTER_0.match2_val      = "0xFFFFFFFF";
TILE1.COUNTER_0.reset           = "COUNTER_0.count_match2";
TILE1.COUNTER_0.match1_val      = "0x2";
TILE1.COUNTER_1.$name           = "COUNTER_1";
TILE1.COUNTER_1.action          = "Add";
TILE1.COUNTER_1.event_load_val  = "1";
TILE1.COUNTER_1.event           = "COUNTER_0.count_match1";
TILE1.COUNTER_1.reset           = "COUNTER_1.count_match2";
TILE1.COUNTER_1.match1_val      = "0xFFFFFFFF";
TILE1.COUNTER_2.$name           = "COUNTER_2";
TILE1.COUNTER_2.event_load_val  = "1";
TILE1.COUNTER_2.action          = "Add";
TILE1.COUNTER_2.event           = "COUNTER_0.count_match1";
TILE1.COUNTER_2.reset           = "COUNTER_1.count_match2";
TILE1.COUNTER_2.match1_val      = "0xFFFFFFFF";
TILE1.COUNTER_2.match2_val      = "0xFFFFFFFF";
TILE1.OUTLUT_0.$name            = "OUTLUT_0";
TILE1.OUTLUT_0.i0               = "FSM_1.OUT";
TILE1.OUTLUT_0.eqn              = "i0";
TILE1.OUTLUT_1.$name            = "OUTLUT_1";
TILE1.OUTLUT_2.$name            = "OUTLUT_2";
TILE1.OUTLUT_2.i0               = "FSM_2.S0";
TILE1.OUTLUT_2.eqn              = "i0";
TILE1.OUTLUT_3.$name            = "OUTLUT_3";
TILE1.OUTLUT_3.eqn              = "0";
TILE1.OUTLUT_4.$name            = "OUTLUT_4";
TILE1.OUTLUT_4.i0               = "FSM_0.S0";
TILE1.OUTLUT_4.eqn              = "i0";
TILE1.OUTLUT_5.$name            = "OUTLUT_5";
TILE1.OUTLUT_5.i0               = "FSM_0.S1";
TILE1.OUTLUT_5.eqn              = "i0";
TILE1.OUTLUT_6.$name            = "OUTLUT_6";
TILE1.OUTLUT_7.$name            = "OUTLUT_7";
TILE1.HLC.$name                 = "HLC_0";
TILE1.HLC.e2                    = "COUNTER_1.count_match2";
TILE1.HLC.R3_init               = "0xFFFFFFFF";
TILE1.HLC.e0                    = "BOUNDARY.in0";
TILE1.HLC.e1                    = "BOUNDARY.in0";
TILE1.HLC.FIFO2_init             = "20";
TILE1.HLC.FIFO1_init             = "10";
TILE1.HLC.FIFO3_init             = "30";
TILE1.HLC.FIFO0_init             = "11";
TILE1.HLC.program0.$name        = "HLCP_0";
TILE1.HLC.program0.instruct0    = "MOV_T1 R2, C1";
TILE1.HLC.program0.instruct1    = "MOV_T2 R3, C1";
TILE1.HLC.program0.instruct2    = "PULL R0";
TILE1.HLC.program0.instruct3    = "MOV_T2 R0, C1";
TILE1.HLC.program0.instruct4    = "PULL R1";
TILE1.HLC.program0.instruct6    = "PULL R0";
TILE1.HLC.program0.instruct7    = "MOV_T1 R0, C2";
TILE1.HLC.program0.instruct5    = "MOV_T2 R1, C0";
TILE1.HLC.program1.$name        = "HLCP_1";
TILE1.HLC.program1.instruct0    = "PULL R0";
TILE1.HLC.program1.instruct1    = "MOV_T2 R0, C2";
TILE1.HLC.program1.instruct4    = "MOV_T1 R3, C1";
TILE1.HLC.program1.instruct2    = "MOV R1, C0";
TILE1.HLC.program1.instruct3    = "INTR 1";
TILE1.HLC.program2.$name        = "HLCP_2";
TILE1.HLC.program2.instruct0    = "INTR 2";
TILE1.HLC.program3.$name        = "HLCP_3";
TILE1.AOC_0.$name               = "AOC_0";
TILE1.AOC_1.$name               = "AOC_1";
TILE1.AOC_2.$name               = "AOC_2";
TILE1.AOC_3.$name               = "AOC_3";
TILE1.AOC_4.$name               = "AOC_4";
TILE1.AOC_5.$name               = "AOC_5";
TILE1.AOC_6.$name               = "AOC_6";
TILE1.AOC_7.$name               = "AOC_7";
