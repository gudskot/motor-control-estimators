/**
 * @cliArgs --device "F2837xD" --package "F2837xD_337ZWT" --part "F2837xD_337ZWT" --context "CPU1" --product "C2000WARE@5.00.00.00"
 * @versions {"tool":"1.17.0+3091"}
 */

/**
 * Import the modules used in this configuration.
 */
const TILE                             = scripting.addModule("/utilities/clb_tool/clb_syscfg/source/TILE");
const TILE1                            = TILE.addInstance();
const clb_run_dynamic_template_clb_c   = scripting.addModule("/utilities/clb_tool/clb_syscfg/source/clb_run_dynamic_template_clb_c.js");
const clb_run_dynamic_template_clb_dot = scripting.addModule("/utilities/clb_tool/clb_syscfg/source/clb_run_dynamic_template_clb_dot.js");
const clb_run_dynamic_template_clb_h   = scripting.addModule("/utilities/clb_tool/clb_syscfg/source/clb_run_dynamic_template_clb_h.js");
const clb_run_dynamic_template_clb_sim = scripting.addModule("/utilities/clb_tool/clb_syscfg/source/clb_run_dynamic_template_clb_sim.js");

/**
 * Write custom configuration values to the imported modules.
 */
TILE.generateSimulation = true;
TILE.reset_duration     = 5000;
TILE.sim_duration       = 500000000;
TILE.clock_period       = 10000;

TILE1.$name                            = "TILE1";
TILE1.BOUNDARY.$name                   = "BOUNDARY0";
TILE1.BOUNDARY.in_period1              = 100;
TILE1.BOUNDARY.in_period5              = 7;
TILE1.BOUNDARY.in_duty5                = 4;
TILE1.BOUNDARY.in_period3              = 9;
TILE1.BOUNDARY.boundaryInput3          = "customWave";
TILE1.BOUNDARY.boundaryInput5          = "customWave";
TILE1.BOUNDARY.boundaryInput2          = "customWave";
TILE1.BOUNDARY.in_sync_2_cycle_delay_3 = true;
TILE1.BOUNDARY.in_sync_2_cycle_delay_5 = true;
TILE1.BOUNDARY.in_initial_value0       = 1;
TILE1.BOUNDARY.boundaryInput0          = "customWave";
TILE1.BOUNDARY.in_custom_source5       = "#define full 8\n#define half 4\nlow(20)\nlow(half)\n\nrpt(5)\nhigh(full)\nlow(full)\nrpt_end\n\nrpt(8)\nhigh(full)\nlow(full)\nrpt_end\n\nrpt(10)\nhigh(full)\nlow(full)\nrpt_end\n\nrpt(3)\nhigh(full)\nlow(full)\nrpt_end\n\nrpt(3)\nlow(full)\nlow(full)\nrpt_end\n\nrpt(6)\nhigh(full)\nlow(full)\nrpt_end\n\nrpt(6)\nhigh(full)\nlow(full)\nrpt_end\n\nrpt(6)\nhigh(full)\nlow(full)\nrpt_end\n\nrpt(6)\nhigh(full)\nlow(full)\nrpt_end\nlow(half)\nlow(full)\n\nrpt(6)\nhigh(full)\nlow(full)\nrpt_end\n";
TILE1.BOUNDARY.in_custom_source3       = "#define full 8\n#define half 4\nlow(20)\n\nrpt(5)\nhigh(full)\nlow(full)\nrpt_end\nlow(full)\n\nrpt(8)\nhigh(full)\nlow(full)\nrpt_end\nlow(full)\n\nrpt(10)\nhigh(full)\nlow(full)\nrpt_end\nlow(full)\n\nrpt(3)\nlow(full)\nlow(full)\nrpt_end\n\nrpt(3)\nhigh(full)\nlow(full)\nrpt_end\n\nrpt(6)\nhigh(full)\nlow(full)\nrpt_end\nlow(half)\n\nrpt(6)\nhigh(full)\nlow(full)\nrpt_end\nlow(half)\n\nrpt(6)\nhigh(full)\nlow(full)\nrpt_end\nlow(half)\n\nrpt(6)\nhigh(full)\nlow(full)\nrpt_end\n\nrpt(6)\nhigh(full)\nlow(full)\nrpt_end\n";
TILE1.BOUNDARY.boundaryInput1          = "squareWave";
TILE1.BOUNDARY.in_duty1                = 2;
TILE1.BOUNDARY.in_repeat_count1        = 6;
TILE1.BOUNDARY.in_custom_source0       = "high(20)\nlow(250)\nhigh(1)\nlow(1)";
TILE1.BOUNDARY.in_custom_source2       = "low(20)\nlow(20)\nhigh(100)\nlow(20)\nhigh(1)";
TILE1.BOUNDARY.input_pipeline2         = true;
TILE1.BOUNDARY.input_pipeline1         = true;
TILE1.BOUNDARY.input_pipeline0         = true;
TILE1.LUT_0.$name                      = "LUT_0";
TILE1.LUT_0.eqn                        = " (!i2 & !i3 & !i0 & i1) | (!i2 & i3 & i0 & i1) | (i2 & !i3 & !i0 & !i1) | (i2 & i3 & i0 & !i1)";
TILE1.LUT_0.i0                         = "FSM_0.S0";
TILE1.LUT_0.i1                         = "FSM_0.S1";
TILE1.LUT_0.i2                         = "BOUNDARY.in3";
TILE1.LUT_0.i3                         = "BOUNDARY.in5";
TILE1.LUT_0.lutDescription             = "Count direction control\ni0,i1: QEP-A/B previous sample\ni2,i3: QEP-A/B current sample\nout: DIRECTION";
TILE1.LUT_1.$name                      = "LUT_1";
TILE1.LUT_1.i1                         = "FSM_0.OUT";
TILE1.LUT_1.i0                         = "BOUNDARY.in2";
TILE1.LUT_1.eqn                        = "i0 & i1";
TILE1.LUT_1.lutDescription             = "Count enable control\ni0: QEP_ENABLE\ni1: QCLK\nout: ENABLE";
TILE1.LUT_2.$name                      = "LUT_2";
TILE1.LUT_2.i0                         = "BOUNDARY.in0";
TILE1.LUT_2.i1                         = "COUNTER_0.count_match1";
TILE1.LUT_2.eqn                        = "i0 | i1";
TILE1.LUT_2.lutDescription             = "QEP reset generation\ni0: QEP_RESET\ni1: COUNTER_MAX_REACHED\nout: COUNTER_RESET";
TILE1.FSM_0.$name                      = "FSM_0";
TILE1.FSM_0.e0                         = "BOUNDARY.in3";
TILE1.FSM_0.e1                         = "BOUNDARY.in5";
TILE1.FSM_0.eqn_out                    = "(!e0 & !e1 & !s0 & s1) + (!e0 & !e1 & s0 & !s1) + (!e0 & e1 & !s0 & !s1) + (!e0 & e1 & s0 & s1) + (e0 & !e1 & !s0 & !s1) + (e0 & !e1 & s0 & s1) + (e0 & e1 & !s0 & s1) + (e0 & e1 & s0 & !s1)";
TILE1.FSM_0.eqn_s0                     = "e0";
TILE1.FSM_0.eqn_s1                     = "e1";
TILE1.FSM_0.fsmDescription             = "QCLK state machine\ne0: QEP-A current sample\ne1: QEP-B current sample\ns0: QEP-A previous sample\ns1: QEP-B previous sample\nout: QCLK";
TILE1.FSM_1.$name                      = "FSM_1";
TILE1.FSM_1.e0                         = "FSM_0.S0";
TILE1.FSM_1.xe0                        = "BOUNDARY.in3";
TILE1.FSM_1.e1                         = "FSM_0.S1";
TILE1.FSM_1.xe1                        = "BOUNDARY.in5";
TILE1.FSM_1.eqn_out                    = "(!xe0 & !xe1 & e0 & e1) + (!xe0 & xe1 & e0 & !e1 ) + (xe0 & !xe1 & !e0 & e1) + (xe0 & xe1 & !e0 & !e1)";
TILE1.FSM_1.fsmDescription             = "Error detection\ne0, e1: QEP-A/B previous sample\nxe0, xe1: QEP-A/B current sample\nout: ERROR";
TILE1.FSM_2.$name                      = "FSM_2";
TILE1.COUNTER_0.$name                  = "COUNTER_0";
TILE1.COUNTER_0.mode0                  = "LUT_1.OUT";
TILE1.COUNTER_0.action                 = "Load";
TILE1.COUNTER_0.match1_val             = "20";
TILE1.COUNTER_0.event                  = "COUNTER_0.count_match2";
TILE1.COUNTER_0.mode1                  = "LUT_0.OUT";
TILE1.COUNTER_0.match2_val             = "0xFFFFFFFF";
TILE1.COUNTER_0.event_load_val         = "19";
TILE1.COUNTER_0.reset                  = "LUT_2.OUT";
TILE1.COUNTER_0.counterDescription     = "QEP position counter\nmatch1: COUNTER_MAX_REACHED\nmatch2: COUNTER_RELOAD_MAX";
TILE1.COUNTER_1.$name                  = "COUNTER_1";
TILE1.COUNTER_2.$name                  = "COUNTER_2";
TILE1.OUTLUT_0.$name                   = "OUTLUT_0";
TILE1.OUTLUT_1.$name                   = "OUTLUT_1";
TILE1.OUTLUT_2.$name                   = "OUTLUT_2";
TILE1.OUTLUT_3.$name                   = "OUTLUT_3";
TILE1.OUTLUT_4.$name                   = "OUTLUT_4";
TILE1.OUTLUT_5.$name                   = "OUTLUT_5";
TILE1.OUTLUT_6.$name                   = "OUTLUT_6";
TILE1.OUTLUT_7.$name                   = "OUTLUT_7";
TILE1.HLC.$name                        = "HLC_0";
TILE1.HLC.e0                           = "FSM_1.OUT";
TILE1.HLC.e3                           = "BOUNDARY.in1";
TILE1.HLC.R2_init                      = "5";
TILE1.HLC.hlcDescription               = "event 0: error detected - send interrupt tag 11\nevent 3: QEP-I, capture the current counter into\n         the FIFO, send interrupt tag 5";
TILE1.HLC.program0.$name               = "HLCP_0";
TILE1.HLC.program0.instruct0           = "INTR 11";
TILE1.HLC.program1.$name               = "HLCP_1";
TILE1.HLC.program2.$name               = "HLCP_2";
TILE1.HLC.program3.$name               = "HLCP_3";
TILE1.HLC.program3.instruct0           = "MOV C0, R0";
TILE1.HLC.program3.instruct1           = "PUSH R0";
TILE1.HLC.program3.instruct2           = "INTR 5";
