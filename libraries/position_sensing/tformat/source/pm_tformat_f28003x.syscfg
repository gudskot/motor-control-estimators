/**
 * @cliArgs --device "F28003x" --package "100PZ" --part "F28003x_100PZ" --context "system" --product "C2000WARE@5.00.00.00"
 * @versions {"tool":"1.17.0+3091"}
 */

/**
 * Import the modules used in this configuration.
 */
const clb   = scripting.addModule("/driverlib/clb.js", {}, false);
const clb1  = clb.addInstance();
const clb2  = clb.addInstance();
const TILE  = scripting.addModule("/utilities/clb_tool/clb_syscfg/source/TILE");
const TILE1 = TILE.addInstance();
const TILE2 = TILE.addInstance();

/**
 * Write custom configuration values to the imported modules.
 */
clb1.$name      = "PM_TFORMAT_CLB";
clb1.clbBase    = "CLB2_BASE";
clb1.attachTile = true;
clb1.enableCLB  = true;

clb2.enableCLB           = true;
clb2.attachTile          = true;
clb2.localConfigCLB_IN0  = "CLB_LOCAL_IN_MUX_INPUT1";
clb2.inputTypeCLB_IN0    = "GLOBAL";
clb2.synchronizeCLB_IN0  = true;
clb2.inputTypeCLB_IN1    = "GLOBAL";
clb2.globalConfigCLB_IN1 = "CLB_GLOBAL_IN_MUX_CLB2_OUT17";
clb2.inputTypeCLB_IN2    = "GLOBAL";
clb2.globalConfigCLB_IN2 = "CLB_GLOBAL_IN_MUX_CLB_AUXSIG0";
clb2.synchronizeCLB_IN2  = true;
clb2.synchronizeCLB_IN1  = true;
clb2.inputTypeCLB_IN3    = "GLOBAL";
clb2.globalConfigCLB_IN3 = "CLB_GLOBAL_IN_MUX_CLB2_OUT22";
clb2.globalConfigCLB_IN0 = "CLB_GLOBAL_IN_MUX_CLB1_OUT21";
clb2.$name               = "PM_TFORMAT_RX_CRC";

TILE.generateSimulation = true;
TILE.reset_duration     = 5000;
TILE.sim_duration       = 500000000;
TILE.clock_period       = 8333.3;

clb1.tile                              = TILE1;
TILE1.$name                            = "TileTformat";
TILE1.BOUNDARY.$name                   = "BOUNDARY0";
TILE1.BOUNDARY.in_edge0                = "rising edge";
TILE1.BOUNDARY.in_edge1                = "falling edge";
TILE1.BOUNDARY.in_edge3                = "both edges";
TILE1.BOUNDARY.boundaryInput0          = "customWave";
TILE1.BOUNDARY.input_pipeline0         = true;
TILE1.BOUNDARY.in_custom_source0       = "low(100)\nhigh(20)\nlow(1)";
TILE1.BOUNDARY.boundaryInput1          = "customWave";
TILE1.BOUNDARY.in_sync_2_cycle_delay_1 = true;
TILE1.BOUNDARY.boundaryInput2          = "customWave";
TILE1.BOUNDARY.in_sync_2_cycle_delay_2 = true;
TILE1.BOUNDARY.boundaryInput3          = "customWave";
TILE1.BOUNDARY.in_sync_2_cycle_delay_3 = true;
TILE1.BOUNDARY.in_custom_source1       = "#define one_bit 48\n#define two_bit 96\n#define three_bit 144\n#define four_bit 192\n#define five_bit 240\nhigh(2000)\n\nlow(one_bit)\n\nlow(one_bit)\nhigh(one_bit)\nlow(two_bit)\n\nhigh(one_bit)\nlow(two_bit)\nhigh(one_bit)\n\nhigh(one_bit)\nlow(one_bit)\n\nlow(four_bit)\n\nlow(one_bit)\nhigh(one_bit)\nlow(two_bit)\n\nhigh(one_bit)\nlow(one_bit)\n\nhigh(one_bit)\nlow(three_bit)\n\nhigh(one_bit)\nlow(three_bit)\n\nhigh(one_bit)\nlow(one_bit)\n\nhigh(two_bit)\nlow(two_bit)\n\nlow(one_bit)\nhigh(one_bit)\nlow(one_bit)\nhigh(one_bit)\n\nhigh(one_bit)";
TILE1.BOUNDARY.in_custom_source2       = "#define one_bit 48\n#define two_bit 96\n#define three_bit 144\n#define four_bit 192\n#define five_bit 240\nhigh(2000)\n\nlow(one_bit)\n\nlow(one_bit)\nhigh(one_bit)\nlow(two_bit)\n\nhigh(one_bit)\nlow(two_bit)\nhigh(one_bit)\n\nhigh(one_bit)\nlow(one_bit)\n\nlow(four_bit)\n\nlow(one_bit)\nhigh(one_bit)\nlow(two_bit)\n\nhigh(one_bit)\nlow(one_bit)\n\nhigh(one_bit)\nlow(three_bit)\n\nhigh(one_bit)\nlow(three_bit)\n\nhigh(one_bit)\nlow(one_bit)\n\nhigh(two_bit)\nlow(two_bit)\n\nlow(one_bit)\nhigh(one_bit)\nlow(one_bit)\nhigh(one_bit)\n\nhigh(one_bit)";
TILE1.BOUNDARY.in_custom_source3       = "#define one_bit 48\n#define two_bit 96\n#define three_bit 144\n#define four_bit 192\n#define five_bit 240\nhigh(2000)\n\nlow(one_bit)\n\nlow(one_bit)\nhigh(one_bit)\nlow(two_bit)\n\nhigh(one_bit)\nlow(two_bit)\nhigh(one_bit)\n\nhigh(one_bit)\nlow(one_bit)\n\nlow(four_bit)\n\nlow(one_bit)\nhigh(one_bit)\nlow(two_bit)\n\nhigh(one_bit)\nlow(one_bit)\n\nhigh(one_bit)\nlow(three_bit)\n\nhigh(one_bit)\nlow(three_bit)\n\nhigh(one_bit)\nlow(one_bit)\n\nhigh(two_bit)\nlow(two_bit)\n\nlow(one_bit)\nhigh(one_bit)\nlow(one_bit)\nhigh(one_bit)\n\nhigh(one_bit)";
TILE1.LUT_0.lutDescription             = "- out CLB_SPI_CLK edge reset control.\n- i0 ENCODER_RESPONSE, any edge\n- i1, i2 FRAME_STATE\n- i3 SPI clock width reached\n";
TILE1.LUT_1.lutDescription             = "- out TRANSMIT_OR_RECEIVE_STARTED\n- i0 START_OPERATION\n- i1 ENCODER_RESPONSE falling edge\n- i2, i3 FRAME_STATE\n\n";
TILE1.LUT_2.lutDescription             = "- out Triggers an update of COUNTER1.match2 \n  (CLOCK_COUNT) by the HLC \n  occurs at the start of RECEIVE_DATA\n- i0, i1 FRAME_STATE\n- i2 ENCODER_RESPONSE falling edge";
TILE1.FSM_0.fsmDescription             = "- out is the SPI CLOCK without masking \n  (always active during a frame)\n- e0 CLOCK_FALLING_EDGE mark\n- e1 CLOCK_RISING_EDGE mark";
TILE1.FSM_1.fsmDescription             = "Primary state machine. \nDetects frame transitions from transmit, wait, to receive\n- e0 TRANSMIT_OR_RECEIVE_STARTED\n- e1 CLOCK_COUNT_COMPLETE\n- s0 TRANSMIT_DATA or RECEIVE_DATA\n- s1 WAIT_FOR_DATA or RECEIVE_DATA\n- out FRAME_ACTIVE";
TILE1.FSM_2.fsmDescription             = "- out TxEN generation\n- e0 TRANSMIT_COMPLETE\n- e1 START_OPERATION";
TILE1.COUNTER_0.counterDescription     = "CLB_SPI_CLOCK edge generation\n- reset CLOCK_ALIGNMENT\n- mode0 FRAME_ACTIVE\n- zero match CLOCK_FALLING_EDGE mark\n- match1 CLOCK_RISING_EDGE mark\n- match2 CLOCK_WIDGH_REACHED";
TILE1.COUNTER_1.counterDescription     = "CLOCK counter.\nIncrements on the rising edge of the generated CLOCK\n- reset CLOCK_COUNT_COMPLETE\n- mode0 CLOCK_RISING EDGE\n- match1 TRANSMIT_COMPLETE\n- match2 CLOCK_COUNT_COMPLETE";
TILE1.OUTLUT_0.outlutDescription       = "CLB_SPI_CLOCK\nDirectly clocks the SPI";
TILE1.OUTLUT_1.outlutDescription       = "FRAME_STATE s1\nTo be passed to the CRC tile";
TILE1.OUTLUT_4.outlutDescription       = "TxEN\nRoute to the RS485 logic on BOOSTXL_POSMGR";
TILE1.OUTLUT_5.outlutDescription       = "FRAME_STATE s0\nTo be passed to the CRC tile";
TILE1.OUTLUT_6.outlutDescription       = "CLB_SPI_CLOCK rising edge\nTo be passed to the CRC tile";
TILE1.OUTLUT_7.outlutDescription       = "ENCODER_RESPONSE\nto be passed to the CRC tile";
TILE1.LUT_0.$name                      = "LUT_0";
TILE1.LUT_0.i1                         = "FSM_1.S0";
TILE1.LUT_0.i2                         = "FSM_1.S1";
TILE1.LUT_0.i3                         = "COUNTER_0.count_match2";
TILE1.LUT_0.eqn                        = "( i0 & ((i2 & !i1) | (i2 & i1) ) ) | i3";
TILE1.LUT_0.i0                         = "BOUNDARY.in3";
TILE1.LUT_0.lutDescription             = "- out CLB_SPI_CLK edge reset control.\n- i0 ENCODER_RESPONSE, any edge\n- i1, i2 FRAME_STATE\n- i3 SPI clock width reached\n";
TILE1.LUT_1.$name                      = "LUT_1";
TILE1.LUT_1.i0                         = "BOUNDARY.in0";
TILE1.LUT_1.i1                         = "BOUNDARY.in1";
TILE1.LUT_1.i2                         = "FSM_1.S0";
TILE1.LUT_1.i3                         = "FSM_1.S1";
TILE1.LUT_1.eqn                        = "i0 | (i1 & ((~i2) & i3))";
TILE1.LUT_1.lutDescription             = "- out TRANSMIT_OR_RECEIVE_STARTED\n- i0 START_OPERATION\n- i1 ENCODER_RESPONSE falling edge\n- i2, i3 FRAME_STATE\n\n";
TILE1.LUT_2.$name                      = "LUT_2";
TILE1.LUT_2.eqn                        = "i2 & (i1 & (~i0))";
TILE1.LUT_2.i0                         = "FSM_1.S0";
TILE1.LUT_2.i1                         = "FSM_1.S1";
TILE1.LUT_2.i2                         = "BOUNDARY.in1";
TILE1.LUT_2.lutDescription             = "- out Triggers an update of COUNTER1.match2 \n  (CLOCK_COUNT) by the HLC \n  occurs at the start of RECEIVE_DATA\n- i0, i1 FRAME_STATE\n- i2 ENCODER_RESPONSE falling edge";
TILE1.FSM_0.$name                      = "FSM_0";
TILE1.FSM_0.e1                         = "COUNTER_0.count_zero";
TILE1.FSM_0.e0                         = "COUNTER_0.count_match1";
TILE1.FSM_0.eqn_s0                     = "((~s0) & e0) | (s0& (~e1))";
TILE1.FSM_0.eqn_s1                     = "s1";
TILE1.FSM_0.eqn_out                    = "s0 & (~e1)";
TILE1.FSM_0.fsmDescription             = "- out is the SPI CLOCK without masking \n  (always active during a frame)\n- e0 CLOCK_FALLING_EDGE mark\n- e1 CLOCK_RISING_EDGE mark";
TILE1.FSM_1.$name                      = "FSM_1";
TILE1.FSM_1.eqn_s0                     = "(((~s0)&(~s1)) & e0) | ((s0&(~s1)) & (~e1)) | (((~s0)&(s1)) & e0) | ((s0&s1) & (~e1)) ";
TILE1.FSM_1.eqn_s1                     = "(((s0)&(~s1)) & e1) | ((~s0) & s1) | ((s0 & s1) & (~e1))";
TILE1.FSM_1.e0                         = "LUT_1.OUT";
TILE1.FSM_1.e1                         = "COUNTER_1.count_match2";
TILE1.FSM_1.eqn_out                    = "s0 | s1";
TILE1.FSM_1.fsmDescription             = "Primary state machine. \nDetects frame transitions from transmit, wait, to receive\n- e0 TRANSMIT_OR_RECEIVE_STARTED\n- e1 CLOCK_COUNT_COMPLETE\n- s0 TRANSMIT_DATA or RECEIVE_DATA\n- s1 WAIT_FOR_DATA or RECEIVE_DATA\n- out FRAME_ACTIVE";
TILE1.FSM_2.$name                      = "FSM_2";
TILE1.FSM_2.e0                         = "COUNTER_1.count_match1";
TILE1.FSM_2.e1                         = "BOUNDARY.in0";
TILE1.FSM_2.eqn_s0                     = "((~s0) & e1) | (s0 & (~e0))";
TILE1.FSM_2.eqn_s1                     = "s1";
TILE1.FSM_2.eqn_out                    = "s0";
TILE1.FSM_2.fsmDescription             = "OUT: TxEN generation\n- e0 TRANSMIT_COMPLETE\n- e1 START_OPERATION";
TILE1.COUNTER_0.$name                  = "COUNTER_0";
TILE1.COUNTER_0.reset                  = "LUT_0.OUT";
TILE1.COUNTER_0.mode1                  = "1";
TILE1.COUNTER_0.mode0                  = "FSM_1.OUT";
TILE1.COUNTER_0.match1_val             = "23";
TILE1.COUNTER_0.match2_val             = "47";
TILE1.COUNTER_0.counterDescription     = "CLB_SPI_CLOCK edge generation\n- reset CLOCK_ALIGNMENT\n- mode0 FRAME_ACTIVE\n- zero match CLOCK_FALLING_EDGE mark\n- match1 CLOCK_RISING_EDGE mark\n- match2 CLOCK_WIDGH_REACHED";
TILE1.COUNTER_1.$name                  = "COUNTER_1";
TILE1.COUNTER_1.mode1                  = "1";
TILE1.COUNTER_1.reset                  = "COUNTER_1.count_match2";
TILE1.COUNTER_1.mode0                  = "COUNTER_0.count_match1";
TILE1.COUNTER_1.event_load_val         = "10";
TILE1.COUNTER_1.match1_val             = "11";
TILE1.COUNTER_1.match2_val             = "11";
TILE1.COUNTER_1.counterDescription     = "CLOCK counter.\nIncrements on the rising edge of the generated CLOCK\n- reset CLOCK_COUNT_COMPLETE\n- mode0 CLOCK_RISING EDGE\n- match1 TRANSMIT_COMPLETE\n- match2 CLOCK_COUNT_COMPLETE";
TILE1.COUNTER_2.$name                  = "COUNTER_2";
TILE1.OUTLUT_0.$name                   = "OUTLUT_0";
TILE1.OUTLUT_0.i0                      = "FSM_0.OUT";
TILE1.OUTLUT_0.i1                      = "FSM_1.S0";
TILE1.OUTLUT_0.eqn                     = "~( ~i0 & i1 & i2)";
TILE1.OUTLUT_0.i2                      = "FSM_1.OUT";
TILE1.OUTLUT_0.outlutDescription       = "CLB_SPI_CLOCK\nDirectly clocks the SPI";
TILE1.OUTLUT_1.$name                   = "OUTLUT_1";
TILE1.OUTLUT_1.eqn                     = "i0";
TILE1.OUTLUT_1.i0                      = "FSM_1.S1";
TILE1.OUTLUT_1.outlutDescription       = "FRAME_STATE s1\nTo be passed to the CRC tile";
TILE1.OUTLUT_2.$name                   = "OUTLUT_2";
TILE1.OUTLUT_3.$name                   = "OUTLUT_3";
TILE1.OUTLUT_4.$name                   = "OUTLUT_4";
TILE1.OUTLUT_4.i0                      = "FSM_2.OUT";
TILE1.OUTLUT_4.eqn                     = "i0 & i1";
TILE1.OUTLUT_4.i1                      = "FSM_1.OUT";
TILE1.OUTLUT_4.outlutDescription       = "TxEN\nRoute to the RS485 logic";
TILE1.OUTLUT_5.$name                   = "OUTLUT_5";
TILE1.OUTLUT_5.eqn                     = "i0";
TILE1.OUTLUT_5.i0                      = "FSM_1.S0";
TILE1.OUTLUT_5.outlutDescription       = "FRAME_STATE s0\nTo be passed to the CRC tile";
TILE1.OUTLUT_6.$name                   = "OUTLUT_6";
TILE1.OUTLUT_6.eqn                     = "i0";
TILE1.OUTLUT_6.i0                      = "COUNTER_0.count_match1";
TILE1.OUTLUT_6.outlutDescription       = "CLB_SPI_CLOCK rising edge\nTo be passed to the CRC tile";
TILE1.OUTLUT_7.$name                   = "OUTLUT_7";
TILE1.OUTLUT_7.eqn                     = "i0";
TILE1.OUTLUT_7.i0                      = "BOUNDARY.in2";
TILE1.OUTLUT_7.outlutDescription       = "ENCODER_RESPONSE\nto be passed to the CRC tile";
TILE1.HLC.$name                        = "HLC_0";
TILE1.HLC.e0                           = "LUT_2.OUT";
TILE1.HLC.R0_init                      = "40";
TILE1.HLC.program0.$name               = "HLCP_0";
TILE1.HLC.program0.instruct1           = "ADD R0, R3";
TILE1.HLC.program0.instruct0           = "MOV C1, R3";
TILE1.HLC.program0.instruct2           = "MOV_T2 R3, C1";
TILE1.HLC.program1.$name               = "HLCP_1";
TILE1.HLC.program2.$name               = "HLCP_2";
TILE1.HLC.program3.$name               = "HLCP_3";
TILE1.AOC_0.$name                      = "AOC_0";
TILE1.AOC_1.$name                      = "AOC_1";
TILE1.AOC_2.$name                      = "AOC_2";
TILE1.AOC_3.$name                      = "AOC_3";
TILE1.AOC_4.$name                      = "AOC_4";
TILE1.AOC_5.$name                      = "AOC_5";
TILE1.AOC_6.$name                      = "AOC_6";
TILE1.AOC_7.$name                      = "AOC_7";

clb2.tile                          = TILE2;
TILE2.$name                        = "TileTformatRxCRC";
TILE2.BOUNDARY.$name               = "BOUNDARY1";
TILE2.BOUNDARY.boundaryInput0      = "tileOutput";
TILE2.BOUNDARY.tileSelect0         = "TileTformat";
TILE2.BOUNDARY.tileOutputSelect0   = 5;
TILE2.BOUNDARY.input_pipeline0     = true;
TILE2.BOUNDARY.boundaryInput1      = "tileOutput";
TILE2.BOUNDARY.tileSelect1         = "TileTformat";
TILE2.BOUNDARY.input_pipeline1     = true;
TILE2.BOUNDARY.tileOutputSelect1   = 1;
TILE2.BOUNDARY.boundaryInput2      = "tileOutput";
TILE2.BOUNDARY.tileSelect2         = "TileTformat";
TILE2.BOUNDARY.input_pipeline2     = true;
TILE2.BOUNDARY.tileOutputSelect2   = 7;
TILE2.BOUNDARY.boundaryInput3      = "tileOutput";
TILE2.BOUNDARY.tileSelect3         = "TileTformat";
TILE2.BOUNDARY.input_pipeline3     = true;
TILE2.BOUNDARY.tileOutputSelect3   = 6;
TILE2.BOUNDARY.boundaryInput4      = "tileOutput";
TILE2.BOUNDARY.tileSelect4         = "TileTformat";
TILE2.BOUNDARY.input_pipeline4     = true;
TILE2.BOUNDARY.in_edge4            = "falling edge";
TILE2.BOUNDARY.tileOutputSelect4   = 7;
TILE2.LUT_0.lutDescription         = "Field count control\n- i0, i1 FRAME_STATE";
TILE2.LUT_2.lutDescription         = "Clock qualification\nmasks the clock rising edge except\nwhen COUNT_BITSs is active (low)\n- i0 COUNT_BITSn\n- i1 CLOCK_RISING_EDGE\n- out INCREMENT_BIT_COUNT";
TILE2.LUT_1.lutDescription         = "CRC shift control\nShifts the CRC generation counter\nwhen the data is part of the CRC\ncalculation.\n- i0 CLOCK_RISING_EDGE\n- i1 DATA_VALID\n- i2 RECEIVE_DATAn\n- i3 CRC_DATA_FIELD\n- out SHIFT_ENABLE (1 CLB CLK)";
TILE2.FSM_0.fsmDescription         = "Field data mask\nMasks the start and delimiter bits \nin each response field.\n- e0 DATA_START\n- e1 DATA_END\n- s0 DATA_VALID";
TILE2.FSM_1.fsmDescription         = "Data-bit count control\nEnable data-bit count when receiving\nbits used to calculate the CRC\n- e0 ENCODER_RESPONSE falling edge\n- e1 DATA_END";
TILE2.COUNTER_0.counterDescription = "Bit count\nMark the start and end of the\n8-bit data in each field.\nExclude the start and delimiter\n- reset COUNT_BITSn\n- event INCREMENT_BIT_COUNT\n- match1 DATA_START\n- match2 DATA_END";
TILE2.COUNTER_1.counterDescription = "Field count\nIncrements at the start of \neach field.\n- reset RECEIVE_DATAn\n- event DATA_START\n- match1 marks the start of the \n  CRC field";
TILE2.COUNTER_2.counterDescription = "CRC generator\nConfigured as a serializer\nin LFSR mode\n- event ENCODER_RESPONSE\n- mode0 SHIFT_ENABLE one clb clk wide";
TILE2.LUT_0.$name                  = "LUT_3";
TILE2.LUT_0.i1                     = "BOUNDARY.in1";
TILE2.LUT_0.eqn                    = "! (i0 & i1)";
TILE2.LUT_0.i0                     = "BOUNDARY.in0";
TILE2.LUT_0.lutDescription         = "Field count control\n- i0, i1 FRAME_STATE";
TILE2.LUT_1.$name                  = "LUT_4";
TILE2.LUT_1.i0                     = "BOUNDARY.in3";
TILE2.LUT_1.i1                     = "FSM_0.S0";
TILE2.LUT_1.i3                     = "COUNTER_1.count_match1";
TILE2.LUT_1.i2                     = "COUNTER_1.count_zero";
TILE2.LUT_1.eqn                    = "(i0 & i1) & (!i2 & !i3)";
TILE2.LUT_1.lutDescription         = "CRC shift control\nShifts the CRC generation counter\nwhen the data is part of the CRC\ncalculation.\n- i0 CLOCK_RISING_EDGE\n- i1 DATA_VALID\n- i2 RECEIVE_DATAn\n- i3 CRC_DATA_FIELD\n- out SHIFT_ENABLE (1 CLB CLK)";
TILE2.LUT_2.$name                  = "LUT_5";
TILE2.LUT_2.i1                     = "BOUNDARY.in3";
TILE2.LUT_2.eqn                    = "(i1 & !i0)";
TILE2.LUT_2.i0                     = "FSM_1.OUT";
TILE2.LUT_2.lutDescription         = "Clock qualification\nmasks the clock rising edge except\nwhen COUNT_BITSs is active (low)\n- i0 COUNT_BITSn\n- i1 CLOCK_RISING_EDGE\n- out INCREMENT_BIT_COUNT";
TILE2.FSM_0.$name                  = "FSM_3";
TILE2.FSM_0.eqn_s0                 = "(e0&s0) | ((!e0)&(!e1)&s0) | (e0&(!e1)&(!s0))";
TILE2.FSM_0.e0                     = "COUNTER_0.count_match1";
TILE2.FSM_0.e1                     = "COUNTER_0.count_match2";
TILE2.FSM_0.fsmDescription         = "Field data mask\nMasks the start and delimiter bits \nin each response field.\n- e0 DATA_START\n- e1 DATA_END\n- s0 DATA_VALID";
TILE2.FSM_1.$name                  = "FSM_4";
TILE2.FSM_1.e1                     = "COUNTER_0.count_match2";
TILE2.FSM_1.e0                     = "BOUNDARY.in4";
TILE2.FSM_1.eqn_out                = "s0";
TILE2.FSM_1.eqn_s0                 = "(s0 & s1) | e1 | (!e1 & e0 & !s1 & s0)";
TILE2.FSM_1.eqn_s1                 = "(s1 & s0 & !e1 & !e0) | (e1 & !s1 & !s0) | (e1 & s1 & s0)";
TILE2.FSM_1.fsmDescription         = "Data-bit count control\nEnable data-bit count when receiving\nbits used to calculate the CRC\n- e0 ENCODER_RESPONSE falling edge\n- e1 DATA_END";
TILE2.FSM_2.$name                  = "FSM_5";
TILE2.COUNTER_0.$name              = "COUNTER_3";
TILE2.COUNTER_0.mode1              = "1";
TILE2.COUNTER_0.match1_val         = "1";
TILE2.COUNTER_0.match2_val         = "9";
TILE2.COUNTER_0.event              = "LUT_2.OUT";
TILE2.COUNTER_0.action             = "Add";
TILE2.COUNTER_0.event_load_val     = "1";
TILE2.COUNTER_0.reset              = "FSM_1.OUT";
TILE2.COUNTER_0.counterDescription = "Bit count\nMark the start and end of the\n8-bit data in each field.\nExclude the start and delimiter\n- reset COUNT_BITSn\n- event INCREMENT_BIT_COUNT\n- match1 DATA_START\n- match2 DATA_END";
TILE2.COUNTER_1.$name              = "COUNTER_4";
TILE2.COUNTER_1.mode1              = "1";
TILE2.COUNTER_1.action             = "Add";
TILE2.COUNTER_1.event_load_val     = "1";
TILE2.COUNTER_1.event              = "COUNTER_0.count_match1";
TILE2.COUNTER_1.reset              = "LUT_0.OUT";
TILE2.COUNTER_1.match1_val         = "4";
TILE2.COUNTER_1.counterDescription = "Field count\nIncrements at the start of \neach field.\n- reset RECEIVE_DATAn\n- event DATA_START\n- match1 marks the start of the \n  CRC field";
TILE2.COUNTER_2.$name              = "COUNTER_5";
TILE2.COUNTER_2.mode0              = "LUT_1.OUT";
TILE2.COUNTER_2.match1_val         = "0x7";
TILE2.COUNTER_2.action             = "Load";
TILE2.COUNTER_2.serializer_en      = true;
TILE2.COUNTER_2.lfsr_en            = true;
TILE2.COUNTER_2.match2_val         = "0x101";
TILE2.COUNTER_2.event              = "BOUNDARY.in2";
TILE2.COUNTER_2.mode1              = "1";
TILE2.COUNTER_2.counterDescription = "CRC generator\nConfigured as a serializer\nin LFSR mode\n- event ENCODER_RESPONSE\n- mode0 SHIFT_ENABLE one clb clk wide";
TILE2.OUTLUT_0.$name               = "OUTLUT_8";
TILE2.OUTLUT_1.$name               = "OUTLUT_9";
TILE2.OUTLUT_2.$name               = "OUTLUT_10";
TILE2.OUTLUT_3.$name               = "OUTLUT_11";
TILE2.OUTLUT_4.$name               = "OUTLUT_12";
TILE2.OUTLUT_5.$name               = "OUTLUT_13";
TILE2.OUTLUT_5.eqn                 = "i0";
TILE2.OUTLUT_5.i0                  = "BOUNDARY.in2";
TILE2.OUTLUT_6.$name               = "OUTLUT_14";
TILE2.OUTLUT_6.eqn                 = "i0";
TILE2.OUTLUT_6.i0                  = "COUNTER_1.count_zero";
TILE2.OUTLUT_7.$name               = "OUTLUT_15";
TILE2.HLC.$name                    = "HLC_1";
TILE2.HLC.e1                       = "BOUNDARY.in1";
TILE2.HLC.e2                       = "COUNTER_1.count_match1";
TILE2.HLC.hlcDescription           = "e1\n- event WAIT_FOR_DATA or RECEIVE_DATA\nClears COUNTER2 by loading it with R0 (zero)\nAssumes that R0 is zero\n\ne2\n- event CRC_DATA_FIELD\nAlerts the CPU that the CRC is complete\nUses Interrupt tag 5";
TILE2.HLC.program0.$name           = "HLCP_4";
TILE2.HLC.program1.$name           = "HLCP_5";
TILE2.HLC.program1.instruct0       = "MOV R2, C2";
TILE2.HLC.program2.$name           = "HLCP_6";
TILE2.HLC.program2.instruct0       = "INTR 5";
TILE2.HLC.program3.$name           = "HLCP_7";
TILE2.AOC_0.$name                  = "AOC_8";
TILE2.AOC_1.$name                  = "AOC_9";
TILE2.AOC_2.$name                  = "AOC_10";
TILE2.AOC_3.$name                  = "AOC_11";
TILE2.AOC_4.$name                  = "AOC_12";
TILE2.AOC_5.$name                  = "AOC_13";
TILE2.AOC_6.$name                  = "AOC_14";
TILE2.AOC_7.$name                  = "AOC_15";
